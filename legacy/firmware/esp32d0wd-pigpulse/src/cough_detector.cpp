/**
 * PigPulse v2.0 - TinyML Cough Detector Implementation
 * ESP32-D0WD pig cough classifier using TFLite Micro (mock model placeholder).
 *
 * Pipeline: pre-emphasis -> Hanning window -> 256-tap FFT -> 64 Mel bands -> 13 MFCCs
 *           -> TFLite Micro inference -> class + confidence
 *
 * Classes: 0=productive_cough, 1=non_cough, 2=environmental_noise
 */

#include "cough_detector.h"
#include <math.h>
#include <string.h>
#include <Arduino.h>

// ============================================================
// MOCK TFLITE MICRO MODEL DATA (~50KB placeholder)
// In production, replace with actual TFLite Micro model binary.
// ============================================================
static const unsigned char model_data[COUGH_MODEL_SIZE] = {
    0x1C, 0x00, 0x00, 0x00, 0x54, 0x46, 0x4C, 0x33,  // TFL3 magic
    0x00, 0x00, 0x00, 0x00, 0x00, 0x00, 0x00, 0x00,
    // ... placeholder bytes (zeros) for model structure ...
    // Real model would be generated by: tflite_convert --output_file=model.tflite
};

// ============================================================
// LOOKUP TABLES (computed once at init)
// ============================================================
static float hanning_window[COUGH_FFT_SIZE];
static float mel_filterbank[COUGH_MEL_BANDS][COUGH_FFT_SIZE / 2 + 1];
static float dct_matrix[COUGH_MFCC_COUNT][COUGH_MEL_BANDS];
static bool tables_initialized = false;

// ============================================================
// INTERNAL STATE
// ============================================================
static bool detector_ready = false;
static float mfcc_buffer[COUGH_MFCC_COUNT];
static float fft_real[COUGH_FFT_SIZE];
static float fft_imag[COUGH_FFT_SIZE];

// ============================================================
// HELPER FUNCTIONS
// ============================================================

/**
 * Convert frequency to Mel scale.
 */
static inline float hz_to_mel(float hz) {
    return 2595.0f * log10f(1.0f + hz / 700.0f);
}

/**
 * Convert Mel to frequency.
 */
static inline float mel_to_hz(float mel) {
    return 700.0f * (powf(10.0f, mel / 2595.0f) - 1.0f);
}

/**
 * Compute Hanning window coefficients.
 */
static void compute_hanning_window() {
    for (int i = 0; i < COUGH_FFT_SIZE; i++) {
        hanning_window[i] = 0.5f * (1.0f - cosf(2.0f * M_PI * i / (COUGH_FFT_SIZE - 1)));
    }
}

/**
 * Compute Mel filterbank (triangular filters).
 */
static void compute_mel_filterbank() {
    float mel_low = hz_to_mel(COUGH_MEL_FREQ_LOW);
    float mel_high = hz_to_mel(COUGH_MEL_FREQ_HIGH);
    float mel_step = (mel_high - mel_low) / (COUGH_MEL_BANDS + 1);

    // Compute center frequencies
    float center_mels[COUGH_MEL_BANDS + 2];
    for (int i = 0; i < COUGH_MEL_BANDS + 2; i++) {
        center_mels[i] = mel_low + i * mel_step;
    }

    // Convert to Hz and then to FFT bin indices
    int bin_indices[COUGH_MEL_BANDS + 2];
    for (int i = 0; i < COUGH_MEL_BANDS + 2; i++) {
        float hz = mel_to_hz(center_mels[i]);
        bin_indices[i] = (int)floorf((COUGH_FFT_SIZE + 1) * hz / COUGH_SAMPLE_RATE);
        if (bin_indices[i] > COUGH_FFT_SIZE / 2) bin_indices[i] = COUGH_FFT_SIZE / 2;
    }

    // Build triangular filters
    memset(mel_filterbank, 0, sizeof(mel_filterbank));
    for (int m = 0; m < COUGH_MEL_BANDS; m++) {
        int f_left = bin_indices[m];
        int f_center = bin_indices[m + 1];
        int f_right = bin_indices[m + 2];

        // Rising slope
        for (int k = f_left; k <= f_center && f_center > f_left; k++) {
            mel_filterbank[m][k] = (float)(k - f_left) / (float)(f_center - f_left);
        }
        // Falling slope
        for (int k = f_center; k <= f_right && f_right > f_center; k++) {
            mel_filterbank[m][k] = (float)(f_right - k) / (float)(f_right - f_center);
        }
    }
}

/**
 * Compute DCT matrix for MFCC computation.
 */
static void compute_dct_matrix() {
    for (int i = 0; i < COUGH_MFCC_COUNT; i++) {
        for (int j = 0; j < COUGH_MEL_BANDS; j++) {
            dct_matrix[i][j] = cosf(M_PI * i * (j + 0.5f) / COUGH_MEL_BANDS);
        }
    }
}

/**
 * Radix-2 FFT (in-place, decimation-in-time).
 * @param real real part of input/output
 * @param imag imaginary part of input/output
 * @param n must be power of 2
 */
static void fft_radix2(float *real, float *imag, int n) {
    // Bit-reversal permutation
    for (int i = 1, j = 0; i < n; i++) {
        int bit = n >> 1;
        for (; j & bit; bit >>= 1) {
            j ^= bit;
        }
        j ^= bit;
        if (i < j) {
            float tmp = real[i]; real[i] = real[j]; real[j] = tmp;
            tmp = imag[i]; imag[i] = imag[j]; imag[j] = tmp;
        }
    }

    // Cooley-Tukey butterfly
    for (int len = 2; len <= n; len <<= 1) {
        float angle = -2.0f * M_PI / len;
        float wlen_cos = cosf(angle);
        float wlen_sin = sinf(angle);
        for (int i = 0; i < n; i += len) {
            float w_real = 1.0f;
            float w_imag = 0.0f;
            for (int j = 0; j < len / 2; j++) {
                int u = i + j;
                int v = i + j + len / 2;
                float u_real = real[u];
                float u_imag = imag[u];
                float v_real = real[v] * w_real - imag[v] * w_imag;
                float v_imag = real[v] * w_imag + imag[v] * w_real;
                real[u] = u_real + v_real;
                imag[u] = u_imag + v_imag;
                real[v] = u_real - v_real;
                imag[v] = u_imag - v_imag;
                float new_w_real = w_real * wlen_cos - w_imag * wlen_sin;
                float new_w_imag = w_real * wlen_sin + w_imag * wlen_cos;
                w_real = new_w_real;
                w_imag = new_w_imag;
            }
        }
    }
}

/**
 * Apply pre-emphasis filter: y[n] = x[n] - alpha * x[n-1]
 */
static void apply_preemphasis(int16_t *samples, int n, float alpha) {
    for (int i = n - 1; i > 0; i--) {
        samples[i] = (int16_t)(samples[i] - alpha * samples[i - 1]);
    }
}

/**
 * Compute power spectrum from FFT output.
 */
static void compute_power_spectrum(float *power, const float *real, const float *imag, int n) {
    for (int i = 0; i <= n / 2; i++) {
        power[i] = real[i] * real[i] + imag[i] * imag[i];
    }
}

/**
 * Apply Mel filterbank to power spectrum.
 */
static void apply_mel_filterbank(float *mel_energies, const float *power) {
    for (int m = 0; m < COUGH_MEL_BANDS; m++) {
        float energy = 0.0f;
        for (int k = 0; k <= COUGH_FFT_SIZE / 2; k++) {
            energy += mel_filterbank[m][k] * power[k];
        }
        mel_energies[m] = logf(energy + 1e-10f); // log Mel energies
    }
}

/**
 * Apply DCT to get MFCCs.
 */
static void compute_mfccs(float *mfccs, const float *mel_energies) {
    for (int i = 0; i < COUGH_MFCC_COUNT; i++) {
        float sum = 0.0f;
        for (int j = 0; j < COUGH_MEL_BANDS; j++) {
            sum += dct_matrix[i][j] * mel_energies[j];
        }
        mfccs[i] = sum;
    }
}

/**
 * Mock TFLite Micro inference.
 * In production, this would invoke TFLite Micro interpreter.
 * For now, uses a simple heuristic based on MFCC energy distribution.
 * @param mfccs 13 MFCC coefficients
 * @return class_id (0, 1, or 2)
 */
static int mock_tflite_inference(const float *mfccs) {
    // Heuristic: productive coughs have strong low-frequency energy (MFCC[0])
    // and moderate high-frequency content. Environmental noise tends to be
    // more uniform across bands. Non-cough has lower overall energy.

    float total_energy = 0.0f;
    float low_freq_ratio = 0.0f;

    for (int i = 0; i < COUGH_MFCC_COUNT; i++) {
        total_energy += mfccs[i] * mfccs[i];
    }

    // Low-frequency emphasis (first 4 MFCCs)
    float low_energy = 0.0f;
    for (int i = 0; i < 4; i++) {
        low_energy += mfccs[i] * mfccs[i];
    }

    if (total_energy > 0.01f) {
        low_freq_ratio = low_energy / total_energy;
    }

    // Simple decision boundaries (would be learned by real model)
    if (total_energy < 0.005f) {
        return CLASS_NON_COUGH;  // very low energy = silence/non-cough
    } else if (low_freq_ratio > 0.6f) {
        return CLASS_PRODUCTIVE_COUGH;  // strong low-freq = cough
    } else {
        return CLASS_ENVIRONMENTAL_NOISE;  // distributed spectrum = noise
    }
}

/**
 * Mock softmax for confidence calculation.
 */
static float mock_softmax_confidence(const float *mfccs, int class_id) {
    // Simulate confidence based on how clearly the features match the class
    float total_energy = 0.0f;
    for (int i = 0; i < COUGH_MFCC_COUNT; i++) {
        total_energy += fabsf(mfccs[i]);
    }

    // Base confidence on signal strength (stronger signal = more confident)
    float confidence = 0.5f + 0.4f * fminf(total_energy / 10.0f, 1.0f);

    // Add some class-specific bias
    if (class_id == CLASS_PRODUCTIVE_COUGH && mfccs[0] > 0.5f) {
        confidence += 0.1f;
    }

    return fminf(confidence, 0.99f);
}

// ============================================================
// PUBLIC API
// ============================================================

bool cough_detector_init() {
    if (detector_ready) return true;

    // Compute lookup tables
    compute_hanning_window();
    compute_mel_filterbank();
    compute_dct_matrix();
    tables_initialized = true;

    // Verify model data is accessible (placeholder check)
    if (model_data[0] != 0x1C || model_data[1] != 0x00) {
        // Model header invalid - but we proceed with mock inference
        DEBUG_PRINTLN("[CoughDetector] Model header invalid, using mock inference");
    }

    detector_ready = true;
    DEBUG_PRINTLN("[CoughDetector] Initialized (mock TFLite Micro, 64 Mel bands, 13 MFCCs)");
    return true;
}

cough_result_t cough_detector_infer(int16_t* audio_samples) {
    cough_result_t result = { CLASS_NON_COUGH, 0.0f, "non_cough" };

    if (!detector_ready || audio_samples == NULL) {
        return result;
    }

    // Step 1: Pre-emphasis filter
    int16_t frame[COUGH_FRAME_SAMPLES];
    memcpy(frame, audio_samples, COUGH_FRAME_SAMPLES * sizeof(int16_t));
    apply_preemphasis(frame, COUGH_FRAME_SAMPLES, COUGH_PREEMPH_ALPHA);

    // Step 2: Apply Hanning window to first FFT_SIZE samples
    for (int i = 0; i < COUGH_FFT_SIZE; i++) {
        fft_real[i] = frame[i] * hanning_window[i] / 32768.0f;
        fft_imag[i] = 0.0f;
    }

    // Step 3: FFT
    fft_radix2(fft_real, fft_imag, COUGH_FFT_SIZE);

    // Step 4: Power spectrum
    float power_spectrum[COUGH_FFT_SIZE / 2 + 1];
    compute_power_spectrum(power_spectrum, fft_real, fft_imag, COUGH_FFT_SIZE);

    // Step 5: Mel filterbank
    float mel_energies[COUGH_MEL_BANDS];
    apply_mel_filterbank(mel_energies, power_spectrum);

    // Step 6: MFCCs
    compute_mfccs(mfcc_buffer, mel_energies);

    // Step 7: TFLite Micro inference (mock)
    result.class_id = mock_tflite_inference(mfcc_buffer);
    result.confidence = mock_softmax_confidence(mfcc_buffer, result.class_id);
    result.class_name = cough_detector_getLabel(result.class_id);

    return result;
}

const char* cough_detector_getLabel(int class_id) {
    switch (class_id) {
        case CLASS_PRODUCTIVE_COUGH: return "productive_cough";
        case CLASS_NON_COUGH: return "non_cough";
        case CLASS_ENVIRONMENTAL_NOISE: return "environmental_noise";
        default: return "unknown";
    }
}
